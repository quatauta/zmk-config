/* source key position labels */
#include "zmk-helpers/key-labels/kyria.h"

#include <behaviors.dtsi>
#include <behaviors/num_word.dtsi> // Requires zmk-auto-layer module.
#include <behaviors/unicode.dtsi> // Requires zmk-unicode module.
#include <zmk-helpers/helper.h> // Requires zmk-helpers module.
#include <dt-bindings/zmk/keys.h>
#include <dt-bindings/zmk/bt.h>
#include <dt-bindings/zmk/outputs.h>

// Must match ZMK_LAYER order below.
#define DEF 0
#define NAV 1
#define FN 2
#define NUM 3
#define SYS 4
#define MOUSE 5

#define XXX &none
#define ___ &trans

/* Global defaults */

#define QUICK_TAP_MS 175

&sk {
  release-after-ms = <900>;
  quick-release;
};

&sl { // Allow sticky mods to chord across sticky layers.
  ignore-modifiers;
};

&lt {
  flavor = "balanced";
  tapping-term-ms = <200>;
  quick-tap-ms = <QUICK_TAP_MS>;
};

/* Homerow mods */
#undef THUMBS
#define THUMBS LH0 LH1 LH2 LH3 LH4 LF1 LF0 RH0 RH1 RH2 RH3 RH4 RF0 RF1  // ponytail: override to include Kyria extra keys LF0/LF1/RF0/RF1

#define MAKE_HRM(NAME, HOLD, TAP, TRIGGER_POS)                                 \
  ZMK_HOLD_TAP(NAME, bindings = <HOLD>, <TAP>; flavor = "balanced";            \
               tapping-term-ms = <280>; quick-tap-ms = <QUICK_TAP_MS>;         \
               require-prior-idle-ms = <150>; hold-trigger-on-release;         \
               hold-trigger-key-positions = <TRIGGER_POS>;)

MAKE_HRM(hml, &kp, &kp, KEYS_R THUMBS) // Left-hand HRMs.
MAKE_HRM(hmr, &kp, &kp, KEYS_L THUMBS) // Right-hand HRMs.

// Hack: Make HRM combos tap-only (cf, ZMK issue #544).
#define ZMK_COMBO_8(NAME, TAP, POS, LAYERS, COMBO_MS, IDLE_MS, HOLD, SIDE)     \
  MAKE_HRM(hm_combo_##NAME, &kp, TAP, SIDE THUMBS)                             \
  ZMK_COMBO_6(NAME, &hm_combo_##NAME HOLD 0, POS, LAYERS, COMBO_MS, IDLE_MS)

/* Combos, leader key sequences, mouse emulation */

#include "combos.dtsi" // Must be sourced after HRM-combo hack.
#include "leader.dtsi"
#include "mouse.dtsi"

/* Nav cluster */

// Trigger tap-action on all interrupts.
#define MT_CORE                                                                \
  flavor = "tap-preferred";                                                    \
  tapping-term-ms = <220>;                                                     \
  quick-tap-ms = <220>;                                                        \
  hold-trigger-key-positions = <0>;

&mt { MT_CORE };

ZMK_HOLD_TAP(mt_home, bindings = <&masked_home>, <&kp>; MT_CORE)
ZMK_HOLD_TAP(mt_end, bindings = <&masked_end>, <&kp>; MT_CORE)

#define NAV_LEFT  &mt_home 0   LEFT  // Tap: left  | Long-tap: start of line.
#define NAV_RIGHT &mt_end 0    RIGHT // Tap: right | Long-tap: end   of line.
#define NAV_UP    &mt LC(HOME) UP    // Tap: up    | Long-tap: start of doc.
#define NAV_DOWN  &mt LC(END)  DOWN  // Tap: down  | Long-tap: end   of doc.
#define NAV_BSPC  &mt LC(BSPC) BSPC  // Tap: bspc  | Long-tap: delete word bwd.
#define NAV_DEL   &mt LC(DEL)  DEL   // Tap: del   | Long-tap: delete word fwd.

// Mask CTRL on left/right hold to avoid accidental jumps to start/end of doc.
#define MASK_MODS(NAME, MODS, BINDING)                                         \
  ZMK_MOD_MORPH(NAME, bindings = <BINDING>, <BINDING>; mods = <MODS>;)

MASK_MODS(masked_home, (MOD_LCTL), &kp HOME)
MASK_MODS(masked_end,  (MOD_LCTL), &kp END)

/* Magic-shift & auto-layers */

// Tap: repeat after alpha, else sticky-shift |
// Shift + tap/ double-tap: caps-word | Hold: shift.
#define MAGIC_SHIFT &magic_shift LSHFT 0
ZMK_HOLD_TAP(magic_shift, bindings = <&kp>, <&magic_shift_tap>;
             flavor = "balanced"; tapping-term-ms = <200>;
             quick-tap-ms = <QUICK_TAP_MS>;)
ZMK_MOD_MORPH(magic_shift_tap, bindings = <&shift_repeat>, <&caps_word>;
              mods = <(MOD_LSFT)>;)
ZMK_ADAPTIVE_KEY(
    shift_repeat, bindings = <&sk LSHFT>;
    repeat {
      trigger-keys = <A B C D E F G H I J K L M N O P Q R S T U V W X Y Z>;
      bindings = <&key_repeat>;
      max-prior-idle-ms = <1200>;
      strict-modifiers;
    };)
&caps_word { // Mods deactivate caps-word, requires PR #1451. [TODO: rebase]
  /delete-property/ ignore-modifiers;
};

// Tap: num-word | double-tap: sticky num-layer | Hold: num-layer.
#define SMART_NUM &smart_num NUM 0
ZMK_HOLD_TAP(smart_num, bindings = <&mo>, <&num_dance>; flavor = "balanced";
             tapping-term-ms = <200>; quick-tap-ms = <QUICK_TAP_MS>;)
ZMK_TAP_DANCE(num_dance, bindings = <&num_word NUM>, <&sl NUM>;
              tapping-term-ms = <200>;)

// Smart-mouse, requires tri-state module.
ZMK_TRI_STATE(
    smart_mouse, bindings = <&tog MOUSE>, <&none>, <&tog MOUSE>;
    ignored-key-positions =
        <LT1 LT2 LH0 LH1 RT1 RT2 RT3 RM0 RM1 RM2 RM3 RM4 RB1 RB2 RB3 RH0 RH1>;
    ignored-layers = <MOUSE NAV FN>;)

/* Custom behaviors */

// Alt+Tab swapper, requires tri-state module.
ZMK_TRI_STATE(swapper, bindings = <&kt LALT>, <&kp TAB>, <&kt LALT>;
              ignored-key-positions = <LT2 RT2 RM1 RM2 RM3>;)

// Define mod-morph with a *single* mod trigger for less repetition.
#define SIMPLE_MORPH(NAME, MOD, BINDING1, BINDING2)                            \
  ZMK_MOD_MORPH(NAME, mods = <(MOD_L##MOD | MOD_R##MOD)>;                      \
                bindings = <BINDING1>, <BINDING2>;)

// Tap: comma | Shift + tap: semicolon | Ctrl + shift + tap: <.
SIMPLE_MORPH(comma_morph, SFT, &kp COMMA, &comma_inner_morph)
SIMPLE_MORPH(comma_inner_morph, CTL, &kp SEMICOLON, &kp LESS_THAN)

// Tap: dot | Shift + tap: colon | Ctrl + shift + tap: >.
SIMPLE_MORPH(dot_morph, SFT, &kp DOT, &dot_inner_morph)
SIMPLE_MORPH(dot_inner_morph, CTL, &kp COLON, &kp GREATER_THAN)

// Tap: qmark | Shift + tap: excl.
SIMPLE_MORPH(qexcl, SFT, &kp QMARK, &kp EXCL)

// Tap: left/right parenthesis | Shft + tap: less-than/greater-than.
SIMPLE_MORPH(lpar_lt, SFT, &kp LPAR, &kp LT)
SIMPLE_MORPH(rpar_gt, SFT, &kp RPAR, &kp GT)

// Tap: space | Shift + tap: dot -> space -> sticky shift | Hold: nav layer.
ZMK_HOLD_TAP(lt_spc, bindings = <&mo>, <&spc_morph>; flavor = "balanced";
             tapping-term-ms = <200>; quick-tap-ms = <QUICK_TAP_MS>;)
SIMPLE_MORPH(spc_morph, SFT, &kp SPACE, &dot_spc)
ZMK_MACRO(dot_spc, bindings = <&kp DOT &kp SPACE &sk LSHFT>; wait-ms = <0>;
          tap-ms = <5>;)

// Tap: backspace | Lshft + tap: delete | Rshft + tap: shift-delete.
ZMK_MOD_MORPH(bs_del, bindings = <&kp BSPC>, <&kp DEL>;
              mods = <(MOD_LSFT|MOD_RSFT)>; keep-mods = <MOD_RSFT>;)

// Tap: copy | double-tap: cut.
ZMK_TAP_DANCE(copy_cut, bindings = <&kp LC(INS)>, <&kp LC(X)>;
              tapping-term-ms = <200>;)

// Sticky shift + leader.
ZMK_MACRO(leader_sft, bindings = <&sk LSHFT &leader>;)

// misc aliases
#define CANCEL      &kp K_CANCEL         // cancel caps-word, num-word and smart-mouse
#define DSK_PREV    &kp LC(LEFT)         // Previous desktop
#define DSK_NEXT    &kp LC(RIGHT)        // Next     desktop
#define DSK_W_PREV  &kp LC(LA(LEFT))     // Window to previous desktop
#define DSK_W_NEXT  &kp LC(LA(RIGHT))    // Window to next     desktop
#define PIN_WIN     &kp LG(LC(LS(Q)))    // Pin window across desktops
#define PIN_APP     &kp LG(LC(LS(A)))    // Pin application across desktops
#define DSK_MGR     &kp LA(GRAVE)        // Desktop manager
#define VOL_DOWN    &hmr RSHFT C_VOL_DN

ZMK_UNICODE_SINGLE(sym_le, N2, N2, N6, N4) // ≤ (less-than or equal to)
ZMK_UNICODE_SINGLE(sym_ge, N2, N2, N6, N5) // ≥ (greater-than or equal to)

/* Keymap */

ZMK_CONDITIONAL_LAYER(sys, FN NUM, SYS) // FN + NUM --> SYS.

ZMK_LAYER(base,
//─────────────┬───────────────┬───────────────┬───────────────┬───────────────┬───────────────╮                                                                ╭───────────────┬───────────────┬───────────────┬───────────────┬───────────────┬───────────────╮
&kp TAB        &kp Q           &kp W           &kp E           &kp R           &kp T                                                                            &kp Y           &kp U           &kp I           &kp O           &kp P           &kp PLUS
&kp LCTRL      &hml LGUI A     &hml LALT S     &hml LSHFT D    &hml LCTRL F    &kp G                                                                            &kp H           &hmr LCTRL J    &hmr RSHFT K    &hmr LALT L     &hmr LGUI SQT   &kp HASH
&kp LSHFT      &kp Z           &kp X           &kp C           &kp V           &kp B            ___            ___              ___             ___             &kp N           &kp M           &comma_morph    &dot_morph      &qexcl          &kp RSHFT
                                               ___             ___             &lt_spc NAV DEF  &lt FN RET     ___              ___             SMART_NUM       MAGIC_SHIFT     ___             ___
//                                             ╰───────────────┴───────────────┴───────────────┴───────────────┴───────────────╯╰───────────────┴───────────────┴───────────────┴───────────────┴───────────────╯
)

ZMK_LAYER(nav,
//─────────────┬───────────────┬───────────────┬───────────────┬───────────────┬───────────────╮                                                                ╭───────────────┬───────────────┬───────────────┬───────────────┬───────────────┬───────────────╮
___            ___             ___             &kp LS(TAB)     &swapper        ___                                                                              &kp PG_UP       NAV_BSPC        NAV_UP          NAV_DEL         ___             ___
___            &sk LGUI        &sk LALT        &sk LSHFT       &sk LCTRL       ___                                                                              &kp PG_DN       NAV_LEFT        NAV_DOWN        NAV_RIGHT       &kp RET         ___
___            ___             ___             ___             ___             ___             ___             ___              ___             ___             &kp INS         &kp TAB         &kp LT          &kp GT          ___             ___
                                               ___             ___             ___             ___             ___              ___             ___             CANCEL          ___             ___
//                                             ╰───────────────┴───────────────┴───────────────┴───────────────┴───────────────╯╰───────────────┴───────────────┴───────────────┴───────────────┴───────────────╯
)

ZMK_LAYER(fn,
//─────────────┬───────────────┬───────────────┬───────────────┬───────────────┬───────────────╮                                                                ╭───────────────┬───────────────┬───────────────┬───────────────┬───────────────┬───────────────╮
___            &kp F12         &kp F7          &kp F8          &kp F9          ___                                                                              &kp C_BRI_UP    &kp C_PREV      &kp C_VOL_UP    &kp C_NEXT      ___             ___
___            &hml LGUI F11   &hml LALT F4    &hml LSHFT F5   &hml LCTRL F6   ___                                                                              &kp C_BRI_DN    DSK_PREV        VOL_DOWN        DSK_NEXT        ___             ___
___            &kp F10         &kp F1          &kp F2          &kp F3          ___             ___             ___              ___             ___             ___             DSK_W_PREV      ___             DSK_W_NEXT      ___             ___
                                               ___             ___             ___             ___             ___              ___             &kp C_MUTE      &kp C_PP        ___             ___
//                                             ╰───────────────┴───────────────┴───────────────┴───────────────┴───────────────╯╰───────────────┴───────────────┴───────────────┴───────────────┴───────────────╯
)

ZMK_LAYER(num,
//─────────────┬───────────────┬───────────────┬───────────────┬───────────────┬───────────────╮                                                                ╭───────────────┬───────────────┬───────────────┬───────────────┬───────────────┬───────────────╮
___            ___             &kp N7          &kp N8          &kp N9          ___                                                                              ___             ___             ___             ___             ___             ___
___            &hml LGUI N0    &hml LALT N4    &hml LSHFT N5   &hml LCTRL N6   ___                                                                              ___             ___             ___             ___             ___             ___
___            ___             &kp N1          &kp N2          &kp N3          ___             ___             ___              ___             ___             ___             ___             ___             ___             ___             ___
                                               ___             ___             ___             ___             ___              ___             ___             CANCEL          ___             ___
//                                             ╰───────────────┴───────────────┴───────────────┴───────────────┴───────────────╯╰───────────────┴───────────────┴───────────────┴───────────────┴───────────────╯
)

ZMK_LAYER(sys,
//─────────────┬───────────────┬───────────────┬───────────────┬───────────────┬───────────────╮                                                                ╭───────────────┬───────────────┬───────────────┬───────────────┬───────────────┬───────────────╮
___            &bt BT_SEL 0    &bt BT_SEL 1    &bt BT_SEL 2    &bt BT_SEL 3    &bt BT_SEL 4                                                                     ___             ___             ___             ___             ___             ___
___            ___             ___             ___             &studio_unlock  &bootloader                                                                      &bootloader     ___             ___             ___             ___             ___
___            ___             ___             ___             ___             &sys_reset      &bt BT_CLR      &out OUT_TOG     ___             ___             &sys_reset      ___             ___             ___             ___             ___
                                               ___             ___             ___             ___             ___              ___             ___             ___             ___             ___
//                                             ╰───────────────┴───────────────┴───────────────┴───────────────┴───────────────╯╰───────────────┴───────────────┴───────────────┴───────────────┴───────────────╯
)

ZMK_LAYER(mouse,
//─────────────┬───────────────┬───────────────┬───────────────┬───────────────┬───────────────╮                                                                ╭───────────────┬───────────────┬───────────────┬───────────────┬───────────────┬───────────────╮
___            ___             ___             ___             ___             ___                                                                              U_WH_L          U_WH_D          U_MS_U          U_WH_U          U_WH_R          ___
___            ___             ___             ___             ___             ___                                                                              ___             U_MS_L          U_MS_D          U_MS_R          ___             ___
___            ___             ___             ___             ___             ___             ___             ___              ___             ___             ___             &mkp MB4        &mkp MCLK       &mkp MB5        ___             ___
                                               ___             ___             ___             ___             ___              ___             &mkp LCLK       &mkp RCLK       ___             ___
//                                             ╰───────────────┴───────────────┴───────────────┴───────────────┴───────────────╯╰───────────────┴───────────────┴───────────────┴───────────────┴───────────────╯
)

/* vim: set ft=c tw=226: */
